## Documentation/devicetree/bindings/clock/exynos7885-g3d-clock.txt
```
Samsung Exynos7885/7904 G3D clock controller
==========================================

CMU_G3D contains the dedicated PLL1417X G3D PLL, the G3D switch-user and
BUSD muxes, the BUSP divider and GPU/AXI Q-channel gates. BUSD has no
separate divider. The switch source comes from CMU_TOP's shared PLL0 /2
through CLKCMU_G3D_SWITCH; the user mux can instead select the 26 MHz
oscillator.

Required properties:
- compatible: must be "samsung,exynos7885-cmu-g3d".
- reg: CMU_G3D register range, base 0x11400000, size 0x8000.
- #clock-cells: must be 1. IDs are in dt-bindings/clock/exynos7885.h.
  GATE_AGPU_G3D retains its vendor ID; the added CCF IDs start at 341.
- clocks: CMU_TOP OSCCLK and DOUT_G3D_SWITCH input clocks.
- clock-names: "osc", "switch", respectively.
- power-domains: a phandle to the G3D generic power domain.

The provider is a platform device, not an early OF clock initializer:
CMU_G3D must be powered before accessing clock registers. Runtime PM is
not enabled on the provider yet. The BUSP divider retains the firmware
ratio; the two muxes and the dedicated G3D PLL can be programmed. The
consumer must switch BUSD away from the PLL before changing its rate.
The PLL driver rejects programming while BUSD selects the PLL.

Experimental M20 Mali consumer:
- compatible: "samsung,exynos7904-mali", "arm,mali".
- vdd-supply: S2MPU08 BUCK5 (vdd_g3d), already exposed by the board PMIC.
  BUCK5 is externally controlled; its regulator enable operation does not
  replace PMU domain sequencing. No voltage is selected by this port.
- clock-names: "g3d", "pll", "busd", "switch", "osc", "cmu", "sysreg",
  "lhm-sfr", "lhm-p", "lhs-d", "lhs-sfr".
- clocks: matching clocks GATE_AGPU_G3D, PLL_OUT_G3D, MOUT_G3D_BUSD,
  MOUT_G3D_SWITCH_USER, OSCCLK (from CMU_TOP), GATE_G3D_CMU,
  GATE_G3D_SYSREG, GATE_G3D_LHM_SFR, GATE_G3D_LHM_P, GATE_G3D_LHS_D,
  GATE_G3D_LHS_SFR.

The Exynos platform owns these named clocks and the vdd regulator, instead
of the Mali core's generic first-clock probing. The existing "clock"
sysfs attribute uses kHz; CCF uses Hz. Zero releases a manual clock
request (there is no governor to resume with DVFS disabled). Unsupported
rates and frequency increases are rejected: OPP/ASV voltage policy is
not ported. Firmware frequency and voltage are retained at probe.
The 343000 kHz DVFS metadata in the vendor board variant is not applied
and does not add a 343 MHz entry to the vendor PLL table.

TODO(5.10 port): validate AGPU's inferred BUSD parent, oscillator fallback
switching under GPU load, and suspend/resume context management before
enabling DVFS or runtime PM. The default M20 DT does not include this
provider; it is opted into only by exynos7904-m20lte-gpu.dts.
```

## Documentation/devicetree/bindings/mmc/exynos-dw-mshc.txt
```
* Samsung Exynos specific extensions to the Synopsys Designware Mobile
  Storage Host Controller

The Synopsys designware mobile storage host controller is used to interface
a SoC with storage medium such as eMMC or SD/MMC cards. This file documents
differences between the core Synopsys dw mshc controller properties described
by synopsys-dw-mshc.txt and the properties used by the Samsung Exynos specific
extensions to the Synopsys Designware Mobile Storage Host Controller.

Required Properties:

* compatible: should be
	- "samsung,exynos4210-dw-mshc": for controllers with Samsung Exynos4210
	  specific extensions.
	- "samsung,exynos4412-dw-mshc": for controllers with Samsung Exynos4412
	  specific extensions.
	- "samsung,exynos5250-dw-mshc": for controllers with Samsung Exynos5250
	  specific extensions.
	- "samsung,exynos5420-dw-mshc": for controllers with Samsung Exynos5420
	  specific extensions.
	- "samsung,exynos7-dw-mshc": for controllers with Samsung Exynos7
	  specific extensions.
	- "samsung,exynos7-dw-mshc-smu": for controllers with Samsung Exynos7
	  specific extensions having an SMU.

* samsung,dw-mshc-ciu-div: Specifies the divider value for the card interface
  unit (ciu) clock. This property is applicable only for Exynos5 SoC's and
  ignored for Exynos4 SoC's. The valid range of divider value is 0 to 7.

* samsung,dw-mshc-sdr-timing: Specifies the value of CIU clock phase shift value
  in transmit mode and CIU clock phase shift value in receive mode for single
  data rate mode operation. Refer notes below for the order of the cells and the
  valid values.

* samsung,dw-mshc-ddr-timing: Specifies the value of CUI clock phase shift value
  in transmit mode and CIU clock phase shift value in receive mode for double
  data rate mode operation. Refer notes below for the order of the cells and the
  valid values.
* samsung,dw-mshc-hs400-timing: Specifies the value of CIU TX and RX clock phase
  shift value for hs400 mode operation.

  Notes for the sdr-timing and ddr-timing values:

    The order of the cells should be
      - First Cell: CIU clock phase shift value for tx mode.
      - Second Cell: CIU clock phase shift value for rx mode.

    Valid values for SDR and DDR CIU clock timing for Exynos5250:
      - valid value for tx phase shift and rx phase shift is 0 to 7.
      - when CIU clock divider value is set to 3, all possible 8 phase shift
        values can be used.
      - if CIU clock divider value is 0 (that is divide by 1), both tx and rx
        phase shift clocks should be 0.

* samsung,read-strobe-delay: RCLK (Data strobe) delay to control HS400 mode
  (Latency value for delay line in Read path)

Exynos7885/7904 vendor-compatible bring-up:

* compatible: "samsung,exynos-dw-mshc" selects the vendor 64-bit register
  layout (CLKSEL at 0xa8), not the older Exynos4/5 layout. This initial port
  supports legacy and high-speed SDR only; do not enable DDR, HS200, HS400,
  enhanced strobe, command queueing or inline encryption capabilities.
* clocks / clock-names: use "biu" for the compound GATE_MMC_EMBD gate and
  "ciu" for UMUX_CLKCMU_FSYS_MMC_EMBD, the actual card input rate. The
  vendor's "ciu_gate" name is not consumed by the 5.10 core. CMU rates
  remain firmware-owned; the core's CLKDIV divides the measured input.
* mmc-exynos-smu: phandle to a node compatible with "samsung,exynos-smu".
  The host calls the vendor secure-firmware service directly, selecting
  standard non-FMP descriptors (type 0), then initializing/resuming SMU.
  Firmware errors fail probe/resume; no guessed protected MMIO writes or
  encryption key operations are performed.
* samsung,dw-mshc-ciu-div: mandatory divider (0..7), matching both timing
  properties' first cells.
* samsung,dw-mshc-sdr-timing / samsung,dw-mshc-ddr-timing: exactly FOUR
  cells, in vendor order: divider (0..7), fine drive (0..3), drive (0..7),
  sample (0..7). The divider is CLKSEL[26:24], fine drive [23:22], drive
  [18:16], sample [2:0]. These are not upstream's two-cell tuples.

The address windows (0x13500000/0x2000, 0x13508000/0x200), IRQ 146,
SMU reference and vendor clock IDs are from Samsung 4.4
arch/arm64/boot/dts/exynos/exynos7885.dtsi:770-794. The existing CMU
provider implements GATE_MMC_EMBD and UMUX_CLKCMU_FSYS_MMC_EMBD;
no invented fixed clock or new CMU register programming is used.

The m20lte values come from Samsung 4.4
arch/arm64/boot/dts/exynos/exynos7904-m20lte_common.dtsi:477-525:
SDR <3 0 4 0>, DDR <3 0 4 2>, divider 3, FIFO depth 0x40, bus width 8.
The original reference-clock table at lines 507-508 is (MHz):
25 50 50 25 50 100 200 50 50 200 200 200. This port caps card frequency
at its high-speed entry (50 MHz), without pretending those CMU reference
rates can yet be programmed. HS200/HS400 timings and delay lines are
present in the source but deliberately deferred, not missing/guessed.
Timing packing and the identification-clock phase-7 disable come from
4.4 drivers/mmc/host/dw_mmc-exynos.h:123-180,283-295 and
4.4 drivers/mmc/host/dw_mmc-exynos.c:298-309,489-572,679-697.
SMU call order/arguments are from 4.4 drivers/mmc/host/dw_mmc.c:4513-4530,
4855-4864, drivers/mmc/host/dw_mmc-exynos-smu.c:105-144,
drivers/crypto/fmp/smu_dev.c:29-89, include/crypto/smu.h:15-37,
and include/linux/smc.h:43-48. The firmware path is used instead of the
no-SMU fallback's direct partition-0 bypass register writes.

Required properties for a slot (Deprecated - Recommend to use one slot per host):

* gpios: specifies a list of gpios used for command, clock and data bus. The
  first gpio is the command line and the second gpio is the clock line. The
  rest of the gpios (depending on the bus-width property) are the data lines in
  no particular order. The format of the gpio specifier depends on the gpio
  controller.
(Deprecated - Refer to Documentation/devicetree/bindings/pinctrl/samsung-pinctrl.txt)

Example:

  The MSHC controller node can be split into two portions, SoC specific and
  board specific portions as listed below.

	dwmmc0@12200000 {
		compatible = "samsung,exynos5250-dw-mshc";
		reg = <0x12200000 0x1000>;
		interrupts = <0 75 0>;
		#address-cells = <1>;
		#size-cells = <0>;
	};

	dwmmc0@12200000 {
		cap-mmc-highspeed;
		cap-sd-highspeed;
		broken-cd;
		fifo-depth = <0x80>;
		card-detect-delay = <200>;
		samsung,dw-mshc-ciu-div = <3>;
		samsung,dw-mshc-sdr-timing = <2 3>;
		samsung,dw-mshc-ddr-timing = <1 2>;
		samsung,dw-mshc-hs400-timing = <0 2>;
		samsung,read-strobe-delay = <90>;
		bus-width = <8>;
	};
```

## Documentation/devicetree/bindings/power/samsung,exynos7885-pd.txt
```
Samsung Exynos7885/Exynos7904 DISPAUD power domain
================================================

Required properties:
- compatible: "samsung,exynos7885-dispaud-pd"
- reg: the domain's PMU configuration/status window, 0x11c84020, size 0x20
- #power-domain-cells: 0
- samsung,pmu: phandle to the Exynos7885 PMU syscon at 0x11c80000
- need_smc: 0x148f0000, the secure peripheral context identifier used by
  SMC 0x82000410 (argument 1: 0 save, 1 restore; argument 2: this identifier)

The dedicated compatible selects the vendor CAL domain ID 0xb1380000 and its
complete on/save/off/status tables; cal_id is therefore not a DT property.
The vendor power-down-ok = PD_OK_AUD policy is not implemented by this binding:
audio/modem firmware and ABOX shutdown integration must not be enabled until
those users participate in runtime PM and their power-down veto is ported.
See Documentation/arm/samsung/exynos7885-pd.rst for the bring-up restrictions.

Consumers use the standard power-domains property. Replace the Samsung 4.4
samsung,power-domain = <&pd_dispaud> with power-domains = <&pd_dispaud>.
Do not keep both properties. The platform bus attaches the consumer to genpd;
the consumer must use runtime PM, and perform suspend before domain power-off.

Example (inside a root with two address and two size cells):

pd_dispaud: power-domain@11c84020 {
	compatible = "samsung,exynos7885-dispaud-pd";
	reg = <0x0 0x11c84020 0x0 0x20>;
	#power-domain-cells = <0>;
	samsung,pmu = <&pmu_system_controller>;
	need_smc = <0x148f0000>;
};

A future ported display consumer's node contains:
	power-domains = <&pd_dispaud>;

This binding does not describe MFCMSCL, ISP, CAM, G3D or logical subdomains.
```
