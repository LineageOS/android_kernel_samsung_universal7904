## drivers/battery_v2/Kconfig
```kconfig
# Samsung universal7904 battery_v2/Kconfig, restricted to M20 options.
menuconfig BATTERY_SAMSUNG
	bool "Samsung M20 battery management"
	depends on POWER_SUPPLY && OF && IIO
	select ALARMTIMER
	help
	  Battery policy and Samsung power_supply ABI from universal7904.
	  MUIC/CCIC cable notifications are not enabled: those controllers and
	  their notifier/USB manager dependencies require a separate full port.

if BATTERY_SAMSUNG
config BATTERY_SAMSUNG_V2
	bool
	default y
config BATTERY_SWELLING
	bool "Swelling protection"
	default y
config BATTERY_AGE_FORECAST
	bool "Battery age forecast"
	default y
config AFC_CHARGER_MODE
	bool "AFC charger mode sysfs"
	default y
config BATTERY_NOTIFIER
	bool "Battery notifier"
	default y
config BATTERY_CISD
	bool "Battery charging statistics"
	default y
config FG_FULLCAP_FROM_BATTERY
	bool "Full capacity from battery data"
	default y
endif

config CHARGER_S2MU004
	bool "Samsung S2MU004 charger"
	depends on BATTERY_SAMSUNG && MFD_S2MU004

config S2MU004_MODE_CHANGE_BY_TOPOFF
	bool "S2MU004 topoff mode switching"
	depends on CHARGER_S2MU004
	default y

config FUELGAUGE_S2MU004
	bool "Samsung S2MU004 fuel gauge"
	depends on BATTERY_SAMSUNG && I2C
```

## drivers/bts/Kconfig
```kconfig
# SPDX-License-Identifier: GPL-2.0-only
config EXYNOS7885_BTS
	bool "Exynos7885/7904 bus traffic shaper"
	depends on ARCH_EXYNOS && OF
	help
	  Build the vendor Exynos7885 TREX QoS/arbitration driver and the
	  bandwidth API used by the Exynos7904 display controller. A matching
	  enabled DT node is required before any registers are accessed.

	  Samsung MIF/INT devfreq and display DVFS are not ported. Bandwidth
	  requirements are tracked, but do not change bus frequencies. This
	  driver alone therefore cannot guarantee display bandwidth.

config EXYNOS7885_BTS_VM
	bool "Exynos7885 BTS VM arbitration policy"
	depends on EXYNOS7885_BTS
	help
	  Select the vendor VM ABOX priority and DREX QoS-7 timeout rather
	  than the default policy. Leave disabled for the stock M20 policy.
```

## drivers/fingerprint/Kconfig
```kconfig
config SENSORS_FINGERPRINT
	bool "Samsung fingerprint sysfs support"

config SENSORS_ET5XX
	bool "Egis ET5xx fingerprint sensor"
	depends on SPI && SENSORS_FINGERPRINT

config SENSORS_ET5XX_SECURE
	bool "ET5xx Trustonic secure mode on Exynos7885/7904"
	depends on SENSORS_ET5XX && TRUSTONIC_TEE && ARCH_EXYNOS
	help
	  Use the secure-world SPI/power ABI expected by the Samsung ET520
	  fingerprint HAL. Sensor SPI transfers remain owned by Trustonic.
```

## drivers/gpu/arm/Kconfig
```kconfig
# SPDX-License-Identifier: GPL-2.0
menu "ARM GPU Configuration"
source "drivers/gpu/arm/b_r26p0/Kconfig"
endmenu
```

## drivers/gud/gud-exynos7885/Kconfig
```kconfig
# SPDX-License-Identifier: GPL-2.0
config TRUSTONIC_TEE
	tristate "Trustonic MobiCore TEE for Exynos 7885/7904"
	depends on ARM64 && OF && MMU
	depends on ARM64_4K_PAGES
	select CRYPTO
	select CRYPTO_SHA1
	select DMA_SHARED_BUFFER
	help
	  Samsung/Trustonic Kinibi driver with the MobiCore 6.3 userspace ABI.
	  Requires compatible secure firmware and a samsung,exynos-tee DT node.

config TRUSTONIC_TEE_LPAE
	bool "Trustonic secure-world LPAE page tables"
	depends on TRUSTONIC_TEE
	default y

config TRUSTONIC_TEE_DEBUG
	bool "Trustonic TEE debug logging"
	depends on TRUSTONIC_TEE
```

## drivers/input/touchscreen/himax_83xxx/Kconfig
```kconfig
config TOUCHSCREEN_HIMAX_COMMON
	tristate "HIMAX chipset i2c touchscreen"
	depends on I2C
	help
	  This enables support for HIMAX CHIPSET over I2C based touchscreens.

config TOUCHSCREEN_HIMAX_INCELL
	tristate "HIMAX chipset in-cell function"
	depends on TOUCHSCREEN_HIMAX_COMMON
	help
	  This enables support for HIMAX CHIPSET of in-cell function.

config TOUCHSCREEN_HIMAX_IC_HX83112
	tristate "HIMAX chipset HX83112 function"
	depends on TOUCHSCREEN_HIMAX_INCELL
	help
	  This enables support for HIMAX CHIPSET of HX83112.

config TOUCHSCREEN_HIMAX_DEBUG
	tristate "HIMAX chipset debug and inspection interface"
	depends on TOUCHSCREEN_HIMAX_COMMON
	help
	  Debug interface and raw-data buffers used by the Himax inspection code.
```

## drivers/media/platform/exynos/Kconfig
```kconfig
# SPDX-License-Identifier: GPL-2.0
menuconfig VIDEO_EXYNOS
	bool "Samsung Exynos vendor media devices"
	depends on ARCH_EXYNOS && VIDEO_V4L2

if VIDEO_EXYNOS
config MEDIA_EXYNOS
	bool
	default y

config EXYNOS_MEDIA_DEVICE
	bool "Exynos media-device glue"
	default y
	select MEDIA_CONTROLLER
	select VIDEO_V4L2_SUBDEV_API

config VIDEO_EXYNOS_FIMC_LEGACY
	bool "Exynos FIMC-IS legacy camera driver (M20 set)"
	depends on VIDEO_EXYNOS && EXYNOS_MEDIA_DEVICE && I2C && OF
	select VIDEOBUF2_DMA_SG
	select VIDEOBUF2_DMA_CONTIG
	help
	  Port of the Samsung 4.4 fimc-legacy FIMC-IS driver, restricted to
	  the m20lte build set. Compile-tested only; needs the FIMC-IS
	  firmware blob via request_firmware.

source "drivers/media/platform/exynos/fimc-legacy/Kconfig"
source "drivers/media/platform/exynos/smfc/Kconfig"
source "drivers/media/platform/exynos/scaler/Kconfig"
source "drivers/media/platform/exynos/g2d1shot/Kconfig"
source "drivers/media/platform/exynos/mfc/Kconfig"

endif
```

## drivers/media/platform/exynos/fimc-legacy/Kconfig
```kconfig
# SPDX-License-Identifier: GPL-2.0
# Resolved m20lte symbol set of the Samsung 4.4 fimc-legacy Kconfig tree.
# Unselected vendor variants (other ISP versions, companions, OIS) are dropped.

config EXYNOS_FIMC_IS
	def_bool y
	depends on VIDEO_EXYNOS_FIMC_LEGACY

config FIMC_IS_V6_20_0_LEGACY
	def_bool y
	depends on EXYNOS_FIMC_IS

config EXYNOS_DEVICE_MIPI_CSIS_VER3
	def_bool y
	depends on EXYNOS_FIMC_IS

config CSIS_V5_0
	def_bool y
	depends on EXYNOS_FIMC_IS

config USE_CSI_DMAOUT_FEATURE
	def_bool y
	depends on EXYNOS_FIMC_IS

config USE_DIRECT_IS_CONTROL
	def_bool y
	depends on EXYNOS_FIMC_IS

config USE_HW_API_COMMON
	def_bool y
	depends on EXYNOS_FIMC_IS

config USE_SENSOR_GROUP
	def_bool y
	depends on EXYNOS_FIMC_IS

config MC_SCALER_V4_20
	def_bool y
	depends on EXYNOS_FIMC_IS

config CAMERA_MC_SCALER_VER2_USE
	def_bool y
	depends on EXYNOS_FIMC_IS

config CAMERA_TDNR_VER2_USE
	def_bool y
	depends on EXYNOS_FIMC_IS

config VENDER_MCD_LEGACY
	def_bool y
	depends on EXYNOS_FIMC_IS

config CAMERA_M20
	def_bool y
	depends on EXYNOS_FIMC_IS

config CAMERA_CIS_SELECT
	def_bool y
	depends on EXYNOS_FIMC_IS
config CAMERA_CIS_5E9_OBJ
	def_bool y
	depends on EXYNOS_FIMC_IS
config CAMERA_CIS_4HA_OBJ
	def_bool y
	depends on EXYNOS_FIMC_IS
config CAMERA_CIS_3L6_OBJ
	def_bool y
	depends on EXYNOS_FIMC_IS
config CAMERA_ACT_SELECT
	def_bool y
	depends on EXYNOS_FIMC_IS
config CAMERA_ACT_DW9808_OBJ
	def_bool y
	depends on EXYNOS_FIMC_IS
config CAMERA_FLASH_SELECT
	def_bool y
	depends on EXYNOS_FIMC_IS
config CAMERA_FLASH_GPIO_OBJ
	def_bool y
	depends on EXYNOS_FIMC_IS
config CAMERA_EEPROM_SUPPORT_REAR
	def_bool y
	depends on EXYNOS_FIMC_IS
config CAMERA_EEPROM_SUPPORT_FRONT
	def_bool y
	depends on EXYNOS_FIMC_IS
config CAMERA_EEPROM_SUPPORT_REAR3
	def_bool y
	depends on EXYNOS_FIMC_IS
```

## drivers/media/platform/exynos/g2d1shot/Kconfig
```kconfig
#
# Copyright (c) 2015 Samsung Electronics Co., Ltd.
#		http://www.samsung.com/
#
# Licensed under GPLv2

config VIDEO_EXYNOS_G2D1SHOT
	bool "Exynos G2D (m2m1shot2, /dev/fimg2d)"
	depends on ARCH_EXYNOS && IOMMU_DMA
	select MEDIA_M2M1SHOT2
```

## drivers/media/platform/exynos/mfc/Kconfig
```kconfig
config VIDEO_EXYNOS_MFC
	bool "Exynos MFC video codec (M20 5.10 port)"
	depends on VIDEO_EXYNOS && OF && CAMERA_M20
	select VIDEOBUF2_DMA_CONTIG
	help
	  Samsung MFC v6.x hardware video encoder/decoder used by the
	  Exynos OMX components (s5p-mfc-dec / s5p-mfc-enc nodes).
```

## drivers/media/platform/exynos/scaler/Kconfig
```kconfig
config VIDEO_EXYNOS_SCALER
	bool "EXYNOS Scaler Driver"
	depends on VIDEO_EXYNOS && OF && CAMERA_M20
	select V4L2_MEM2MEM_DEV
	select VIDEOBUF2_DMA_CONTIG
	default n
	help
	  This is a v4l2 driver for EXYNOS Scaler (MSCL) device.

config SCALER_NO_SOFTRST
	bool "Ignore SOFT_RESET control"
	depends on VIDEO_EXYNOS_SCALER
	default n
	help
	  This disables SOFT_RESET control for Exynos Scaler initial settings.
```

## drivers/misc/samsung/scsc_bt/Kconfig
```kconfig
config SCSC_BT
	tristate "SCSC MX BT support"
	depends on SCSC_CORE

config SCSC_BT_BLUEZ
	default n
	tristate "SCSC MX BlueZ support"
	depends on SCSC_CORE

config SCSC_ANT
	default n
	tristate "SCSC MX ANT support"
	depends on SCSC_CORE
	help
	  This module adds support for using a ANT character device.
```

## drivers/sensors/Kconfig
```kconfig
# SPDX-License-Identifier: GPL-2.0
menuconfig SENSORS
	bool "Samsung sensor drivers (m20lte)"
	help
	  Ported from the Samsung 4.4 kernel for the Galaxy M20.

if SENSORS

config SENSORS_CORE
	bool "Sensors class (/sys/class/sensors)"

config SENSORS_LSM6DSL
	tristate "STMicroelectronics LSM6DSL accel/gyro core"
	depends on SYSFS && SENSORS_CORE

config SENSORS_LSM6DSL_I2C
	tristate "LSM6DSL I2C"
	depends on I2C && SENSORS_LSM6DSL

config SENSORS_YAS539
	tristate "Yamaha YAS539 magnetometer"
	depends on I2C && SENSORS_CORE

config SENSORS_GP2AP110S
	tristate "Sharp GP2AP110S proximity/light"
	depends on I2C && SENSORS_CORE

config SENSORS_TC3XXK
	tristate "Coreriver TC3XXK grip sensor"
	depends on I2C && SENSORS_CORE

endif
```

## drivers/soc/samsung/Kconfig
```kconfig
# SPDX-License-Identifier: GPL-2.0
#
# Samsung SoC drivers
#
menuconfig SOC_SAMSUNG
	bool "Samsung SoC driver support" if COMPILE_TEST

if SOC_SAMSUNG

# There is no need to enable these drivers for ARMv8
config EXYNOS_ASV_ARM
	bool "Exynos ASV ARMv7-specific driver extensions" if COMPILE_TEST
	depends on EXYNOS_CHIPID

config EXYNOS_CHIPID
	bool "Exynos ChipID controller and ASV driver" if COMPILE_TEST
	depends on ARCH_EXYNOS || COMPILE_TEST
	select EXYNOS_ASV_ARM if ARM && ARCH_EXYNOS
	select MFD_SYSCON
	select SOC_BUS
	help
	  Support for Samsung Exynos SoC ChipID and Adaptive Supply Voltage.

config EXYNOS_PMU
	bool "Exynos PMU controller driver" if COMPILE_TEST
	depends on ARCH_EXYNOS || ((ARM || ARM64) && COMPILE_TEST)
	select EXYNOS_PMU_ARM_DRIVERS if ARM && ARCH_EXYNOS

# There is no need to enable these drivers for ARMv8
config EXYNOS_PMU_ARM_DRIVERS
	bool "Exynos PMU ARMv7-specific driver extensions" if COMPILE_TEST
	depends on EXYNOS_PMU

config EXYNOS_PM_DOMAINS
	bool "Exynos PM domains" if COMPILE_TEST
	depends on (ARCH_EXYNOS && PM_GENERIC_DOMAINS) || COMPILE_TEST

config EXYNOS7885_PM_DOMAINS
	bool "Exynos7885 DISPAUD power domain"
	depends on ARCH_EXYNOS && ARM64 && OF && PM
	select PM_GENERIC_DOMAINS
	select EXYNOS7885_PMUCAL
	help
	  Register the DISPAUD domain using the Samsung local PMUCAL sequences
	  and secure peripheral save/restore. Other domains are not supported.
	  Audio/CP-call firmware policy and ABOX shutdown are not ported; do not
	  enable audio or modem firmware users until they participate in genpd.

config EXYNOS7885_PMU_LPM
	bool "Exynos7885 PMU low-power init and CPU power sequences"
	depends on EXYNOS7885_PM_DOMAINS && ARM_PSCI_FW
	select EXYNOS7885_PMUCAL
	default y
	help
	  Run the 4.4 pmucal_system lpm_init sequence (CPUn_OPTION wake-up
	  enables, central sequencer options) and the per-core/cluster PMU
	  power sequences on CPU hotplug.  Required by the CPU idle C2 state.
	  Suspend-to-RAM itself is EXYNOS7885_SLEEP.

config EXYNOS7885_SLEEP
	bool "Exynos7885 SoC sleep (suspend-to-RAM)"
	depends on EXYNOS7885_PMU_LPM && SUSPEND
	help
	  Enter the Exynos7885 SYS_SLEEP power mode on suspend, using the
	  Samsung 4.4 PMU sequences and the vendor PSCI system-sleep state,
	  instead of suspend-to-idle.

config EXYNOS7885_PMUCAL
	bool
	depends on ARCH_EXYNOS && ARM64
	select MFD_SYSCON

config SAMSUNG_PM_DEBUG
	bool "Samsung PM Suspend debug"
	depends on PM && DEBUG_KERNEL
	depends on PLAT_S3C24XX || ARCH_S3C64XX || ARCH_S5PV210
	depends on DEBUG_S3C24XX_UART || DEBUG_S3C2410_UART
	depends on DEBUG_LL && MMU
	help
	  Say Y here if you want verbose debugging from the PM Suspend and
	  Resume code. See <file:Documentation/arm/samsung-s3c24xx/suspend.rst>
	  for more information.

config S3C_PM_DEBUG_LED_SMDK
       bool "SMDK LED suspend/resume debugging"
       depends on PM && (MACH_SMDK6410)
       help
         Say Y here to enable the use of the SMDK LEDs on the baseboard
	 for debugging of the state of the suspend and resume process.

	 Note, this currently only works for S3C64XX based SMDK boards.

config SAMSUNG_PM_CHECK
	bool "S3C2410 PM Suspend Memory CRC"
	depends on PM && (PLAT_S3C24XX || ARCH_S3C64XX || ARCH_S5PV210)
	select CRC32
	help
	  Enable the PM code's memory area checksum over sleep. This option
	  will generate CRCs of all blocks of memory, and store them before
	  going to sleep. The blocks are then checked on resume for any
	  errors.

	  Note, this can take several seconds depending on memory size
	  and CPU speed.

	  See <file:Documentation/arm/samsung-s3c24xx/suspend.rst>

config SAMSUNG_PM_CHECK_CHUNKSIZE
	int "S3C2410 PM Suspend CRC Chunksize (KiB)"
	depends on PM && SAMSUNG_PM_CHECK
	default 64
	help
	  Set the chunksize in Kilobytes of the CRC for checking memory
	  corruption over suspend and resume. A smaller value will mean that
	  the CRC data block will take more memory, but will identify any
	  faults with better precision.

	  See <file:Documentation/arm/samsung-s3c24xx/suspend.rst>

config EXYNOS_SECMEM
	bool "Exynos secure-memory userspace interface"
	depends on ARCH_EXYNOS && ARM64
	help
	  Provide the legacy /dev/s5p-smem ioctl interface used by Exynos
	  userspace. Secure ION heap queries and MIF QoS are not yet supported.
	  This interface alone does not provide protected-buffer allocation.

config EXYNOS_REGULATOR_COUPLER
	bool "Exynos SoC Regulator Coupler" if COMPILE_TEST
	depends on ARCH_EXYNOS || COMPILE_TEST
config ECT
	bool "Exynos Characteristic Table (ECT) parser"
	depends on ARCH_EXYNOS && OF
	help
	  Parse the bootloader-provided ECT blob (thermal, DVFS, min-lock
	  tables) described by the /ect DT node.

config ECT_DUMP
	bool "ECT debugfs dump"
	depends on ECT && DEBUG_FS

endif

config EXYNOS_ACPM
	bool "Exynos ACPM (APM firmware IPC) driver"
	depends on ARCH_EXYNOS
	default y
	help
	  Mailbox IPC to the APM (ACPM) firmware. Used by the S2MPU08 PMIC on M20.

config CP_PMUCAL
	bool "Exynos7885 CP power sequences"
	depends on ARCH_EXYNOS && ARM64
	select EXYNOS_PMU
	help
	  Samsung CP secure power/reset sequences. No sequence runs at init.

config CP_SECURE_BOOT
	bool
	default y if CP_PMUCAL
config EXYNOS_ACPM_DVFS
	bool "Exynos ACPM DVFS requests"
	depends on EXYNOS_ACPM
	default n
	help
	  Frequency/voltage requests to the APM firmware (MIF, INT, CPU clusters,
	  G3D, FSYS, CAM, DISP, AUD). Needed by the GPU driver.
```

## drivers/staging/android/ion/Kconfig
```kconfig
# SPDX-License-Identifier: GPL-2.0
menuconfig ION
	bool "Ion Memory Manager"
	depends on HAS_DMA && MMU
	select GENERIC_ALLOCATOR
	select DMA_SHARED_BUFFER
	help
	  Choose this option to enable the ION Memory Manager,
	  used by Android to efficiently allocate buffers
	  from userspace that can be shared between drivers.
	  If you're not using Android its probably safe to
	  say N here.

config ION_LEGACY_4_4_ABI
	bool "Legacy 32-bit Linux 4.4 ION allocation ABI"
	depends on ION
	default n
	help
	  Accept the 20-byte handle-returning ALLOC, 8-byte MAP and 4-byte
	  FREE ioctls used by old 32-bit Android vendor libraries. Each open
	  file has its own handle table alongside the unchanged modern ABI.
	  Only registered heap IDs are usable; this does not supply Exynos
	  secure heaps or vendor-specific ioctls and allocation flags.

source "drivers/staging/android/ion/heaps/Kconfig"
```
