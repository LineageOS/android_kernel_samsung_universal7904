// SPDX-License-Identifier: GPL-2.0
/*
 * Optional G3D clocks. Include only in the experimental GPU board variant.
 * Base/size: Samsung 4.4 cal-if/exynos7885/cmucal-sfr.c SFR_BLOCK(G3D).
 * This provider probes after genpd powers CMU_G3D, not during early OF init.
 */
/ {
	cmu_g3d: clock-controller@11400000 {
		compatible = "samsung,exynos7885-cmu-g3d";
		reg = <0x0 0x11400000 0x0 0x8000>;
		#clock-cells = <1>;
		clocks = <&clock OSCCLK>, <&clock DOUT_G3D_SWITCH>;
		clock-names = "osc", "switch";
		power-domains = <&pd_g3d>;
		status = "disabled";
	};
};
